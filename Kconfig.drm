## Kconfig.drm
```kconfig
config DRM_JMGPU
	tristate "Jmgpu JMCore"
	depends on DRM
	depends on SND_PCM
	help
	  Choose this option if you have a Jingjia graphics card. 
          If M is selected, the module will be called jmgpu.
```

## kernel/Kconfig.android
```kconfig
config DRM_MWV207
	tristate "Jmgpu JMCore"
	depends on DRM && SND_PCM
	help
	  Choose this option if you have a Jingjia graphics card. 
          If M is selected, the module will be called jmgpu.
```
